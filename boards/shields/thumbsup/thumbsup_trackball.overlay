#include "thumbsup.dtsi"
#include "pmw3610.dtsi"
#include "split_input.dtsi"
#include "thumbsup-layouts.dtsi"
#include <dt-bindings/zmk/input_transform.h>

#include <dt-bindings/zmk/matrix_transform.h>
#include <input/processors.dtsi>
 
&spi0 {
    status = "okay";
};

&trackball_split_input { // local trackball *split* input device child node
	device = <&trackball>;
};

