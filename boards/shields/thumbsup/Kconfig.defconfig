## boards/shields/thumbsup/Kconfig.defconfig
```kconfig
#config ZMK_LOGGING_MINIMAL
#    bool "Suppress all ZMK debug log messages"
#    default false

if SHIELD_THUMBSUP_DONGLE || SHIELD_THUMBSUP_KEYBOARD || SHIELD_THUMBSUP_TRACKBALL
config ZMK_SPLIT 
    default y
config ZMK_POINTING
    default y
endif

if SHIELD_THUMBSUP_DONGLE
config ZMK_KEYBOARD_NAME
	default "thumbsup"
config ZMK_SPLIT_ROLE_CENTRAL
	default y
#config ZMK_LOG_LEVEL
#    default 5
endif

if SHIELD_THUMBSUP_TRACKBALL
config SPI
    default y
endif

#if SHIELD_THUMBSUP_KEYBOARD
#config I2C
#    default y
#endif
```

## boards/shields/thumbsup/Kconfig.shield
```kconfig
# No whitespace after the comma or in your part name!

config SHIELD_THUMBSUP_KEYBOARD
    def_bool $(shields_list_contains,thumbsup_keyboard)

config SHIELD_THUMBSUP_TRACKBALL
    def_bool $(shields_list_contains,thumbsup_trackball)

config SHIELD_THUMBSUP_DONGLE
	def_bool $(shields_list_contains,thumbsup_dongle)
```

## config/west.yml
```yaml
manifest:
  remotes:
    - name: zmkfirmware
      url-base: https://github.com/zmkfirmware
    - name: ak66666
      url-base: https://github.com/ak66666
    - name: nuovotaka
      url-base: https://github.com/nuovotaka
    - name: petejohanson
      url-base: https://github.com/petejohanson

  projects:
    - name: zmk
      remote: zmkfirmware
      revision: v0.3
      import: app/west.yml
    - name: zmk-pmw3610-driver
      remote: ak66666
      revision: main
    - name: zmk-pointing-acceleration-alpha
      remote: nuovotaka
      revision: main
    - name: cirque-input-module
      remote: petejohanson
      revision: main

  self:
    path: config
```
